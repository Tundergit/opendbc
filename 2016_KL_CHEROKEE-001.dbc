VERSION ""

NS_ :

BS_:

BU_: XXX

BO_ 492 STEERING: 8 XXX
 SG_ STEERING_ANGLE : 3|12@0+ (1,-1024) [0|1] "deg" XXX

CM_ SG_ 492 STEERING_ANGLE "0x400 is 0 degrees, pos is left, neg is right";
