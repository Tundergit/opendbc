VERSION ""

NS_ :

BS_:

BU_: XXX

BO_ 760 ENG_TORQUE_REQUEST: 8 XXX
 SG_ NEW_SIGNAL_1 : 3|12@0+ (0.5,-1024) [0|1] "" XXX
 SG_ NEW_SIGNAL_2 : 19|12@0+ (0.5,-1024) [0|1] "" XXX
